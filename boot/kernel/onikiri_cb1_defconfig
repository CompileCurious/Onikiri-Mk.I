## boot/kernel/onikiri_cb1_defconfig
```kconfig
CONFIG_ARM64=y
CONFIG_64BIT=y
CONFIG_ARCH_SUNXI=y
CONFIG_ARCH_SUNXI_MC_SMP=y
CONFIG_MACH_SUN50I=y
CONFIG_EMBEDDED=y
CONFIG_EXPERT=y
CONFIG_PRINTK=n
CONFIG_BUG=n
CONFIG_ELF_CORE=n
CONFIG_COMPAT=n
CONFIG_FHANDLE=n
CONFIG_SWAP=n
CONFIG_SYSVIPC=n
CONFIG_POSIX_MQUEUE=n
CONFIG_AIO=n
CONFIG_BPF_SYSCALL=n
CONFIG_KALLSYMS=n
CONFIG_BLK_DEV_INITRD=y
CONFIG_RD_GZIP=y
CONFIG_CC_OPTIMIZE_FOR_SIZE=y
CONFIG_INIT_ENV_ARG_LIMIT=8
CONFIG_MODULES=n
CONFIG_DEVTMPFS=y
CONFIG_DEVTMPFS_MOUNT=y
CONFIG_FW_LOADER=n
CONFIG_NET=y
CONFIG_PACKET=y
CONFIG_UNIX=y
CONFIG_INET=y
CONFIG_IPV6=n
CONFIG_NETFILTER=n
CONFIG_CFG80211=y
CONFIG_MAC80211=y
CONFIG_BT=y
CONFIG_BT_HCIUART=y
CONFIG_BT_HCIUART_H4=y
CONFIG_PCI=n
CONFIG_MTD=n
CONFIG_ZRAM=n
CONFIG_SQUASHFS=y
CONFIG_SQUASHFS_XZ=y
CONFIG_OVERLAY_FS=y
CONFIG_TMPFS=y
CONFIG_TMPFS_POSIX_ACL=n
CONFIG_BLK_DEV_LOOP=y
CONFIG_PARTITION_ADVANCED=y
CONFIG_EFI_PARTITION=y
CONFIG_MSDOS_PARTITION=y
CONFIG_MMC=y
CONFIG_MMC_BLOCK=y
CONFIG_MMC_SUNXI=y
CONFIG_EXT4_FS=y
CONFIG_FAT_FS=y
CONFIG_VFAT_FS=y
CONFIG_PROC_FS=y
CONFIG_SYSFS=y
CONFIG_NLS=n
CONFIG_INPUT=y
CONFIG_INPUT_EVDEV=y
CONFIG_INPUT_TOUCHSCREEN=y
CONFIG_I2C=y
CONFIG_SPI=y
CONFIG_GPIO_SYSFS=n
CONFIG_DRM=y
CONFIG_DRM_SIMPLEDRM=y
CONFIG_DRM_SUN4I=y
CONFIG_FB=n
CONFIG_BACKLIGHT_CLASS_DEVICE=y
CONFIG_FRAMEBUFFER_CONSOLE=y
CONFIG_LOGO=n
CONFIG_USB_SUPPORT=y
CONFIG_USB_COMMON=y
CONFIG_USB_DWC2=y
CONFIG_USB_DWC2_DUAL_ROLE=y
CONFIG_USB_GADGET=y
CONFIG_USB_CONFIGFS=y
CONFIG_USB_MASS_STORAGE=n
CONFIG_USB_NET_DRIVERS=n
CONFIG_RFKILL=y
CONFIG_SERIAL_8250=n
CONFIG_SERIAL_SUNXI=y
CONFIG_SERIAL_SUNXI_CONSOLE=y
CONFIG_WLAN=y
CONFIG_BRCMFMAC=y
CONFIG_CRYPTO_AES=y
CONFIG_CRYPTO_SHA256=y
CONFIG_CRYPTO_USER=n
CONFIG_DEBUG_KERNEL=n
CONFIG_MAGIC_SYSRQ=n
CONFIG_FTRACE=n
```
